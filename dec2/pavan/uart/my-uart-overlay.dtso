/dts-v1/;
/plugin/;

/ {
    compatible = "brcm,bcm2711";

    /* Fragment 0: UART device node */
    fragment@0 {
        target-path = "/";
        __overlay__ {
            rpi_uart: uart_driver@0 {
                compatible = "rpi,uart-driver";
                reg = <0x0 0xFE201400 0x0 0x100>; /* matches UART_BASE in driver */
                interrupts = <GIC_SPI 153 IRQ_TYPE_LEVEL_HIGH>; /* optional, not used now */
                status = "okay";
                pinctrl-names = "default";
                pinctrl-0 = <&rpi_uart_pins>;
            };
        };
    };

    /* Fragment 1: Pin configuration */
    fragment@1 {
        target-path = "/";
        __overlay__ {
            rpi_uart_pins: rpi_uart_pins {
                brcm,pins = <14 15>;       /* GPIO14 = TXD, GPIO15 = RXD */
                brcm,function = <4>;       /* ALT0 function for UART0 */
                brcm,pull = <0>;           /* No pull-up/down */
            };
        };
    };
};

